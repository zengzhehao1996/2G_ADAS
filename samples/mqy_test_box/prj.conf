## CMakeLists.txt
```
include($ENV{ZEPHYR_BASE}/cmake/app/boilerplate.cmake NO_POLICY_SCOPE)
project(NONE)


aux_source_directory(src/ SRC)
target_sources(app PRIVATE ${SRC})
```

## prj.conf
```kconfig
CONFIG_GPIO=y
CONFIG_SERIAL=y
CONFIG_UART_INTERRUPT_DRIVEN=y
CONFIG_USE_STM32_HAL_GPIO=y
CONFIG_USE_STM32_HAL_GPIO_EX=y
CONFIG_USE_STM32_HAL_ADC=y
CONFIG_USE_STM32_HAL_ADC_EX=y
CONFIG_USE_STM32_HAL_CAN=y
CONFIG_FLOAT=y
```

## boards/aidong_linde429v13.conf
```kconfig
# Print a banner on the UART on startup.
CONFIG_BOOT_BANNER=y
CONFIG_BUILD_TIMESTAMP=y

# Enable console and printk()
CONFIG_PRINTK=y
CONFIG_STDOUT_CONSOLE=y

# Enable Zephyr application to be booted by MCUboot
CONFIG_BOOTLOADER_MCUBOOT=y

CONFIG_FLASH=y
CONFIG_MPU_ALLOW_FLASH_WRITE=y
CONFIG_IMG_MANAGER=y
CONFIG_MCUBOOT_IMG_MANAGER=y
CONFIG_IMG_BLOCK_BUF_SIZE=512

CONFIG_USE_STM32_HAL_ADC=y
CONFIG_USE_STM32_HAL_ADC_EX=y
```

## src/main.c
```c
/*
 * Copyright (c) 2012-2014 Wind River Systems, Inc.
 *
 * SPDX-License-Identifier: Apache-2.0
 */

#include <kernel.h>
#include <misc/printk.h>
#include <gpio.h>
#include <board.h>
#include "my_misc.h"
#include "hw_can.h"
#include "hw_gpio.h"
#include "hw_rs485.h"
#include "hw_uart.h"
#include "uartThread.h"
#include "gpioThread.h"
#include "thread_led.h"

void main(void)
{ 
  int counter=0;


    thread_led_stat_init();
    thread_led_stat_set(LED_STAT_OFF, 1);
    hw_gpio_init();
    
    startRs485Thread();
    startUartThread();
    startCanThread();
    startGpioThread();
    startTestProcessThread();

  while(1){
    ++counter;
    printk("can send %d count.\n", counter);
    //getTestGpiVal();
    k_sleep(20000);
  }
}

#if 0



#endif
```

## src/canThread.c
```c
#include "canThread.h"
#include "my_misc.h"
#include "hw_can.h"
#define CAN_THREAD_STACK_SIZE 1024

#define CAN_SPEED_ID 0x181
#define CAN_FORK_ID 0x282
#define CAN_BATTERY_SEAT_BRAKE_ID 0x281
#define CAN_WORKHOUR_ID 0x794
#define CAN_WORKHOUR_REQ_ID 0x784

K_THREAD_STACK_DEFINE(g_canThreadStack, CAN_THREAD_STACK_SIZE);
static struct k_thread g_canThread;
static k_tid_t         g_canThreadId;

static void canThreadRun(void* p);
static void can_workhour_test();

static uint8_t canErrCounter = 0;

static char can_speed[8]={0xDC,0x0A, 0x03, 0x04, 0x05, 0x06, 0x40, 0x20}; //10Km/h
static char can_battery[8]={0x40, 0x08, 0x19, 0x3C, 0xF6, 0x09, 0x00, 0x05};//battery:60%
static char can_fork[8] =  {0x40, 0x80, 0x19, 0x20, 0x5D, 0x02, 0x00, 0x05}; //fork move
static char can_workhour[8] = {0x06,0x61,0x14,0x57,0x8E,0x89,0x01,0x00}; //WORK_HOUR=7164h


bool startCanThread(void)
{
    bool ret;

    g_canThreadId =
        k_thread_create(&g_canThread, g_canThreadStack, CAN_THREAD_STACK_SIZE,
                        (k_thread_entry_t)canThreadRun, NULL, NULL, NULL, K_PRIO_COOP(5), 0, 0);
    if(g_canThreadId != 0)
    {
        ret = true;
        print_log("Create can THREAD Id:[ %p ]; Stack:[ %p ]; Size:[ %p ]\n", g_canThreadId,
                  g_canThreadStack, CAN_THREAD_STACK_SIZE);
    }
    else
    {
        ret = false;
        err_log("Create can thread Failed.\n\n");
    }

    return ret;
}
void stopCanThread(void)
{
    //hw_rs485_unint();
    if(0 != g_canThreadId)
    {
        
        k_thread_abort(g_canThreadId);
        g_canThreadId = 0;
        print_log("stop can Thread  success !\n");
    }
}
static void canThreadRun(void* p)
{
    //1.init can
    if(!hw_can_init(true))
    {
        err_log(" can init failed \n");
        return false;
    }
    
    while(1)
    {

        if(!hw_can_write(CAN_SPEED_ID,can_speed,8))
        {
            //print_log("can err!!!!!!!!!!!!!!!!\n");
            canErrCounter++;
        }
        if(!hw_can_write(CAN_FORK_ID,can_fork,8))
        {
            canErrCounter++;
        }
        if(!hw_can_write(CAN_BATTERY_SEAT_BRAKE_ID,can_battery,8))
        {
            canErrCounter++;
        }
    
        //1.work hour rx tx
        can_workhour_test();






        
        if(canErrCounter >=30)
        {
            print_log("can err counter = %d\n",canErrCounter);
            canErrCounter = 0;
            hw_can_init(true);
            k_sleep(100);
        }
        k_sleep(30);
    }
}

void can_workhour_test()
{
  CanRxMsgTypeDef * current_mesg;
  if(hw_can_rx_list_length() <= 0){
    //print_log("list length is 0\n");
    return;
  }
  for(int i=0;i<hw_can_rx_list_length();++i)
  {
    current_mesg = hw_can_rx_list_message(i);
   // 
    if(current_mesg)
    {//if message list
        if(current_mesg->StdId == CAN_WORKHOUR_REQ_ID)
        {
            //print_log("current_mesg->StdId == CAN_WORKHOUR_REQ_ID,data0[%02x],data1[%02x],data2[%02x]\n",current_mesg->Data[0],current_mesg->Data[1],current_mesg->Data[2]);
            if(current_mesg->Data[0] != 0x02 || current_mesg->Data[1] != 0x21 || current_mesg->Data[2] != 0x14)
            {
               // print_log("\nAAAAAAAAAAAAAAAArx work hour can msg data is err!!\n");
                hw_can_rx_list_reset();
                return;

            }

        }
        else
        {
            //print_log("\nAAAAAAAAAAAAAstd id err!!\n");
        }
        hw_can_rx_list_reset();
        if(!hw_can_write(CAN_WORKHOUR_ID,can_workhour,8))
        {
            canErrCounter++;
            print_log("can_workhour send failed\n");
        }
        else
        {
            //print_log("send ok \n");
            hw_can_rx_list_reset();
            break;
        }
    }

  }

}
```

## src/canThread.h
```c
#ifndef __CANTHREA_H__
#define __CANTTHREA_H__
#include <kernel.h>

bool startCanThread(void);
void stopCanThread(void);

#endif
```

## src/crc16.h
```c
#ifndef __CRC_H__
#define __CRC_H__

#include "kernel.h"

unsigned short modbus_crc16(unsigned char *buf, unsigned int bsize);

#endif /*__CRC_H__ */
```

## src/gpioThread.c
```c
#include "gpioThread.h"
#include "my_misc.h"
#include <gpio.h>
#include <board.h>
#define GPIO_THREAD_STACK_SIZE 1024
K_THREAD_STACK_DEFINE(g_gpioThreadStack, GPIO_THREAD_STACK_SIZE);
static struct k_thread g_gpioThread;
static k_tid_t         g_gpioThreadId;

#define VEHICLE_LOCK_VAL    1
#define VEHICLE_UNLOCK_VAL  0
static struct device *g_vehclCtrlRelay;
static bool gpioThreadStartFlag = false;

static bool vehclCtrlrelaySetup();
static bool vehclOpen();
static bool vehclLock();
static void gpioThreadRun(void* p);
static bool testGpiSetup();


#define GPIO_RFID_D0      "GPIOE"
#define GOIO_RFID_D0_PIN       13
static struct device *g_gpio_RFID_D0; 


bool startGpioThread(void)
{
    bool ret;

    g_gpioThreadId =
        k_thread_create(&g_gpioThread, g_gpioThreadStack, GPIO_THREAD_STACK_SIZE,
                        (k_thread_entry_t)gpioThreadRun, NULL, NULL, NULL, K_PRIO_COOP(5), 0, 0);
    if(g_gpioThreadId != 0)
    {
        ret = true;
        print_log("Create gpio THREAD Id:[ %p ]; Stack:[ %p ]; Size:[ %p ]\n", g_gpioThreadId,
                  g_gpioThreadStack, GPIO_THREAD_STACK_SIZE);
    }
    else
    {
        ret = false;
        err_log("Create gpio thread Failed.\n\n");
    }

    return ret;
}
void stopGpioThread(void)
{
    if(0 != g_gpioThreadId)
    {
        
        k_thread_abort(g_gpioThreadId);
        g_gpioThreadId = 0;
        gpioThreadStartFlag = false;
        print_log("stop gpio Thread  success !\n");
    }
}
static void gpioThreadRun(void* p)
{
    //1.init gpio
    if(!vehclCtrlrelaySetup())
    {
        err_log(" vehicle relay setup failed \n");
        return false;
    }

    //2.init test gpi
    if(!testGpiSetup())
    {
        err_log(" testGpiSetup failed \n");
        return false;
    }
    gpioThreadStartFlag = true;
    while(1)
    {
        static uint16_t delayTime = 2 * 1000; 
        vehclOpen();
        k_sleep(delayTime);
        vehclLock();
        k_sleep(delayTime);
    }
}


static bool vehclCtrlrelaySetup()
{
    g_vehclCtrlRelay = device_get_binding(GPIO_VEHCL_CTRL_DELAY_PORT);
    if (!g_vehclCtrlRelay) {
      print_log("Cannot find %p!\n", g_vehclCtrlRelay);
      return false;
    }else{
       print_log("g_vehclCtrlRelay [%p]\n",g_vehclCtrlRelay);
    }
    if (gpio_pin_configure(g_vehclCtrlRelay, GOIO_VEHCL_CTRL_DALAY_PIN, GPIO_DIR_OUT)) {
       print_log("Configure g_vehclCtrlRelay failed");
       return false;
    }
    return true;

}
static bool vehclOpen()
{
    if(gpio_pin_write(g_vehclCtrlRelay, GOIO_VEHCL_CTRL_DALAY_PIN, VEHICLE_UNLOCK_VAL))
    {
        return false;
    }
    return true;
}
static bool vehclLock()
{
    if(gpio_pin_write(g_vehclCtrlRelay, GOIO_VEHCL_CTRL_DALAY_PIN, VEHICLE_LOCK_VAL))
    {
        return false;
    }
    return true;
}

static bool testGpiSetup()
{

    g_gpio_RFID_D0 = device_get_binding(GPIO_RFID_D0);
    if (!g_gpio_RFID_D0) 
    {
      print_log("Cannot find %p!\n", g_gpio_RFID_D0);
      return false;
    }
    else
    {
       print_log("g_gpio_RFID_D0 [%p]\n",g_gpio_RFID_D0);
    }
#if 1
    if (gpio_pin_configure(g_gpio_RFID_D0, GOIO_RFID_D0_PIN, GPIO_DIR_IN)) 
    {
       print_log("Configure g_gpio_RFID_D0 failed");
       return false;
    }
#endif


    return true;
}

bool getTestGpiVal()
{
#if 1
    int32_t val = 0;
    //k_sleep(100);
    gpio_pin_read(g_gpio_RFID_D0,GOIO_RFID_D0_PIN, &val);
   // print_log(" test gpi val[%d]\n",val);
    //k_sleep(100);
    return (val != 0);
    #endif
}
bool isGpioThreadStart()
{
    return gpioThreadStartFlag;
}
```

## src/gpioThread.h
```c
#ifndef __GPIOTHREA_H__
#define __GPIOTHREA_H__
#include <kernel.h>

bool startGpioThread(void);
void stopGpioThread(void);
bool getTestGpiVal();
bool isGpioThreadStart();

#endif
```

## src/hw_can.c
```c
#include "hw_can.h"


#include <kernel.h>
#include <string.h>

/////////////////////////////////////
CAN_HandleTypeDef   CAN1_Handler;
CanTxMsgTypeDef     TxMessage;
CanRxMsgTypeDef     RxMessage;
/////////////////////////////////////

#define HW_CAN_PRESCALER 12 //12 is 500kbps, 6 is 1000kbps
#define HW_CAN_RX_LIST_SIZE 128

static CanRxMsgTypeDef g_rxList[HW_CAN_RX_LIST_SIZE];
static int g_rxLen=0;
static s64_t g_last_rx_ts=0;
static BOOL g_isNormal=FALSE;

ISR_DIRECT_DECLARE(can1_rx0_irqhanlder)
{
  HAL_CAN_IRQHandler(&CAN1_Handler);
  __HAL_CAN_ENABLE_IT(&CAN1_Handler,CAN_IT_FMP0);
}
void HAL_CAN_RxCpltCallback(CAN_HandleTypeDef* hcan)
{
#if 0
  printk("id:0x%x, dlc:%d, data:",CAN1_Handler.pRxMsg->StdId,CAN1_Handler.pRxMsg->DLC);
  for(int i=0;i<CAN1_Handler.pRxMsg->DLC;i++){
    printk("%x ",CAN1_Handler.pRxMsg->Data[i]);
  }
  printk("\r\n");
#endif
  g_last_rx_ts = k_uptime_get();
  if(g_rxLen<HW_CAN_RX_LIST_SIZE){
    memcpy((uint8_t*)&(g_rxList[g_rxLen]),(uint8_t*)(CAN1_Handler.pRxMsg),sizeof(CanRxMsgTypeDef));
    ++g_rxLen;
  }
  
}


BOOL hw_can_init(BOOL isNormal)
{
  CAN_FilterConfTypeDef  CAN1_FilerConf;

  g_rxLen = 0;
    
  CAN1_Handler.Instance=CAN1; 
  CAN1_Handler.pTxMsg=&TxMessage;     
  CAN1_Handler.pRxMsg=&RxMessage;  
  CAN1_Handler.Init.Prescaler=HW_CAN_PRESCALER;//hw_baudrate_to_prescaler(buadrate);
  CAN1_Handler.Init.Mode=(isNormal)?CAN_MODE_NORMAL:CAN_MODE_LOOPBACK;
  CAN1_Handler.Init.SJW=CAN_SJW_1TQ;
  CAN1_Handler.Init.BS1=CAN_BS1_3TQ;
  CAN1_Handler.Init.BS2=CAN_BS2_2TQ;
  CAN1_Handler.Init.TTCM=DISABLE;
  CAN1_Handler.Init.ABOM=DISABLE;
  CAN1_Handler.Init.AWUM=ENABLE;
  CAN1_Handler.Init.NART=ENABLE;
  CAN1_Handler.Init.RFLM=DISABLE;
  CAN1_Handler.Init.TXFP=DISABLE;

  if(HAL_CAN_Init(&CAN1_Handler)!=HAL_OK){
    print_log("Fail here.\n");
    return FALSE;
  }

  CAN1_FilerConf.FilterIdHigh=0X0000;
  CAN1_FilerConf.FilterIdLow=0X0000;
  CAN1_FilerConf.FilterMaskIdHigh=0X0000;
  CAN1_FilerConf.FilterMaskIdLow=0X0000;
  CAN1_FilerConf.FilterFIFOAssignment=CAN_FILTER_FIFO0;
  CAN1_FilerConf.FilterNumber=0;
  CAN1_FilerConf.FilterMode=CAN_FILTERMODE_IDMASK;
  CAN1_FilerConf.FilterScale=CAN_FILTERSCALE_32BIT;
  CAN1_FilerConf.FilterActivation=ENABLE;
  CAN1_FilerConf.BankNumber=14;

  if(HAL_CAN_ConfigFilter(&CAN1_Handler,&CAN1_FilerConf)!=HAL_OK){
    print_log("Fail here.\n");
    return FALSE;
  }

  g_isNormal = isNormal;

  return TRUE;
}
BOOL hw_can_isNormal(void){return g_isNormal;}
void HAL_CAN_MspInit(CAN_HandleTypeDef* hcan)
{
  GPIO_InitTypeDef GPIO_Initure;

  __HAL_RCC_CAN1_CLK_ENABLE();
  __HAL_RCC_GPIOA_CLK_ENABLE();

#if defined(CONFIG_BOARD_AIDONG_LINDE429V13) || defined(CONFIG_BOARD_AIDONG_LINDE429V14)
    GPIO_Initure.Pin=GPIO_PIN_0|GPIO_PIN_1;
    GPIO_Initure.Mode=GPIO_MODE_AF_PP;
    GPIO_Initure.Pull=GPIO_NOPULL;    
    GPIO_Initure.Speed=GPIO_SPEED_FREQ_VERY_HIGH;
    GPIO_Initure.Alternate=GPIO_AF9_CAN1;
      
    HAL_GPIO_Init(GPIOD,&GPIO_Initure);
#endif

  __HAL_CAN_ENABLE_IT(&CAN1_Handler,CAN_IT_FMP0);
  IRQ_CONNECT(CAN1_RX0_IRQn, 0, can1_rx0_irqhanlder, NULL, 0);
  irq_enable(CAN1_RX0_IRQn);
}


BOOL hw_can_write(uint32_t id,uint8_t* data,int len){
  bool ret=false;
  CAN1_Handler.pTxMsg->StdId=id;
  CAN1_Handler.pTxMsg->IDE=CAN_ID_STD;
  CAN1_Handler.pTxMsg->RTR=CAN_RTR_DATA;
  CAN1_Handler.pTxMsg->DLC=len;                

  memcpy((uint8_t*)&(CAN1_Handler.pTxMsg->Data[0]),data,len);
  ret = (HAL_CAN_Transmit(&CAN1_Handler,300)==HAL_OK);
  //print_log("id=0x%x,len=%d,ret=%d\n",id,len,ret);
  return ret;
}

s64_t hw_can_last_rx_ts(void){ return g_last_rx_ts;}
void hw_can_rx_list_reset(void){
  //irq_disable(CAN1_RX0_IRQn);
  g_rxLen = 0;
  //memset((uint8_t*)(&g_rxList[0]),0,sizeof(CanRxMsgTypeDef)*HW_CAN_RX_LIST_SIZE);
  //irq_enable(CAN1_RX0_IRQn);
}
int hw_can_rx_list_length(void){return g_rxLen;}
CanRxMsgTypeDef * hw_can_rx_list_message(int index)
{
  if(index>=0 && index<g_rxLen){
    return &(g_rxList[index]);
  }
  return NULL;
}
```

## src/hw_can.h
```c
#ifndef _HW_CAN_H_
#define _HW_CAN_H_

#include <kernel.h>

#include "my_misc.h"
#include <stm32f4xx.h>
#include "stm32f4xx_hal.h"
#include "stm32f4xx_hal_can.h"


BOOL hw_can_init(BOOL isNormal);
BOOL hw_can_isNormal(void);
BOOL hw_can_write(uint32_t id,uint8_t* data,int len);
s64_t hw_can_last_rx_ts(void);

void hw_can_rx_list_reset(void);
int hw_can_rx_list_length(void);
CanRxMsgTypeDef * hw_can_rx_list_message(int index);


#endif //_HW_CAN_H_
```

## src/hw_gpio.c
```c
#include "hw_gpio.h"
#include <zephyr.h>
#include <misc/printk.h>

#include <device.h>
#include <gpio.h>
#include <misc/util.h>

#define print_log(fmt,arg...) {printk("[%s,%d] ",__FILE__,__LINE__);printk(fmt,##arg);}

// #define CFG_INIT_GPIO_PORT "GPIOB"
// #define CFG_INIT_GPIO_PIN  9
// struct device *hw_gpio_cfg;
#define PWR_HOLD_GPIO_PORT "GPIOC"
#define PWR_HOLD_GPIO_PIN 0
#define LED_GPIO_PORT PWR_HOLD_GPIO_PORT
#define LED_GPIO_PIN 1

struct device *gpio_pin_init(const char *port_name, int pin, int dir)
{
  struct device *dev;

  dev = device_get_binding(port_name);
  if(!dev){
    print_log("Cannot find %s!\n", port_name);
	return NULL;
  }
  if(gpio_pin_configure(dev, pin, dir) == 0){
    return dev;
  }else{
    return NULL;
  }

}

void hw_gpio_init(void)
{
  struct device *gpio_pwr_hold;
  gpio_pwr_hold = gpio_pin_init(PWR_HOLD_GPIO_PORT, PWR_HOLD_GPIO_PIN, GPIO_DIR_OUT);
	if (!gpio_pwr_hold) {
		printk("GPIO %s PIN %d configure failed\n", PWR_HOLD_GPIO_PORT, PWR_HOLD_GPIO_PIN);
		return;
	}
  /* enable PWR_HOLD, to enable battery during power supply loss */
	gpio_pin_write(gpio_pwr_hold, PWR_HOLD_GPIO_PIN, 1);

  struct device *led_stat;
  led_stat = gpio_pin_init(LED_GPIO_PORT,LED_GPIO_PIN,GPIO_DIR_OUT);
  if(!led_stat){
    printk("GPIO %s Pin %d configure failed\n",LED_GPIO_PORT,LED_GPIO_PIN);
  }
  gpio_pin_write(led_stat, LED_GPIO_PIN, 0);

}

// int hw_seat_stat(void)
// {
//   int val=0;
//   gpio_pin_read(hw_gpio_cfg, CFG_INIT_GPIO_PIN, &val);
//   return val;
// }
```

## src/hw_gpio.h
```c
#ifndef __HW_GPIO_H__
#define __HW_GPIO_H__

void hw_gpio_init(void);
struct device *gpio_pin_init(const char *port_name, int pin, int dir);

//int hw_seat_stat(void);

#endif
```

## src/hw_led.c
```c
/*
 * hw_led.c
 *
 *  Created on: Nov 22, 2017
 *      Author: root
 */

#include "hw_led.h"
#include "my_misc.h"
#include <gpio.h>
#include <device.h>
#include "hw_gpio.h"

/* Output - Status LED */
#if defined(CONFIG_BOARD_AIDONG_LINDE429V13)
#define LED_STAT_GPIO_PORT	"GPIOC"
#define LED_STAT_GPIO_PIN	1
#elif defined(CONFIG_BOARD_AIDONG_LINDE429V14)
#define LED_STAT_GPIO_PORT	"GPIOI"
#define LED_STAT_GPIO_PIN	4
#endif


static struct device *gpio_led_stat;

void led_on(void){
  gpio_pin_write(gpio_led_stat, LED_STAT_GPIO_PIN, 0);
  //print_log("Write GPIO pin LED_STAT value %d\n", 1);
}
void led_off(void){
  gpio_pin_write(gpio_led_stat, LED_STAT_GPIO_PIN, 1);
  //print_log("Write GPIO pin LED_STAT value %d\n", 0);
}
void led_init(void){
  gpio_led_stat = gpio_pin_init(LED_STAT_GPIO_PORT, LED_STAT_GPIO_PIN, GPIO_DIR_OUT);
  	if (!gpio_led_stat) {
  		printk("GPIO %s PIN %d configure failed\n", LED_STAT_GPIO_PORT, LED_STAT_GPIO_PIN);
  		return;
  	}
  	gpio_pin_write(gpio_led_stat, LED_STAT_GPIO_PIN, 0);
}
```

## src/hw_led.h
```c
#ifndef HW_LED_H
#define HW_LED_H

#ifdef __cplusplus
extern "C" {
#endif

void led_on(void);
void led_off(void);
void led_init(void);
extern unsigned char led_stat;

#ifdef __cplusplus
}
#endif
#endif // HW_LED_H
```

## src/hw_rs485.c
```c
#ifdef __cplusplus
extern "C" {
#endif
#include "hw_rs485.h"

#include <zephyr.h>
#include <string.h>
#include <kernel.h>
#include <uart.h>
#include <gpio.h>
#include "my_misc.h"

static struct device *g_rs485_dev = NULL;
static void hw_uarts_rs485_isr(struct device *x);
void rs485_direction_setDirection(bool is_tx);

#define UART_PORT_RS485 "UART_7"

#define RS485_MAXSIZE 50
#define RS485_RXSIZE 50

static uint8_t g_rx_buffer[RS485_RXSIZE];
static int g_rx_len=0;

#define RS485_DE_PORT "GPIOE"
#define RS485_DE_PIN 9

static struct device *g_rs485_de = NULL;


#define RS485_TX_MODE 1
#define RS485_RX_MODE 0
bool hw_rs485_init(){
	//init rs485 device
  if((g_rs485_dev = device_get_binding(UART_PORT_RS485)) == NULL) {
    err_log("Fail to get RS485 device %s\n", UART_PORT_RS485);
    return false;
  }

	//init rs485 de pin
  g_rs485_de = device_get_binding(RS485_DE_PORT);
	if(g_rs485_de==NULL){
		err_log("Fail to init rs485de pin.\n");
		return false;
	}
	gpio_pin_configure(g_rs485_de, RS485_DE_PIN, GPIO_DIR_OUT);
  gpio_pin_write(g_rs485_de, RS485_DE_PIN, RS485_RX_MODE);

	//init rx work
	g_rx_len = 0;
	
  uart_irq_callback_set(g_rs485_dev, hw_uarts_rs485_isr);
  uart_irq_rx_disable(g_rs485_dev);
  uart_irq_rx_enable(g_rs485_dev);
  return true;
}

void hw_uarts_rs485_isr(struct device *x){
  ARG_UNUSED(x);
	if(g_rx_len<RS485_RXSIZE){
		int len =  uart_fifo_read(g_rs485_dev,
					                    &g_rx_buffer[g_rx_len],
					                    RS485_MAXSIZE-g_rx_len);
		g_rx_len += len;
	}
    else
    {
        uart_irq_rx_disable(g_rs485_dev);
        err_log("RS485 isr over,rs485 rx buff is full.\n");

    }
}

void hw_rs485_send(uint8_t *data,int len){
  if(data==NULL || len<=0)return;

	int i=0;
    uint8_t sent_char;
	gpio_pin_write(g_rs485_de, RS485_DE_PIN, RS485_TX_MODE);
  
  for (i = 0; i < len; i++) {
    sent_char = uart_poll_out(g_rs485_dev, data[i]);

    if (sent_char != data[i]) {
      err_log("expect send %c, actaul send %c\n", data[i], sent_char);
      break;
    }
  }
	k_sleep(5);
	gpio_pin_write(g_rs485_de, RS485_DE_PIN, RS485_RX_MODE);
}

int  hw_rs485_read(uint8_t * out_data,int size){
  int ret=0;
  uart_irq_rx_disable(g_rs485_dev);

  ret = g_rx_len;
  memcpy(out_data, g_rx_buffer,g_rx_len);
  g_rx_len = 0;
  uart_irq_rx_enable(g_rs485_dev);
  return ret;
}

int  hw_get_rs485_rx_buff_num()
{
    return g_rx_len;
}

#ifdef __cplusplus
}
#endif
```
