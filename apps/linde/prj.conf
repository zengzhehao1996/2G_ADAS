## CMakeLists.txt
```
# Top-level CMakeLists.txt for the skeleton application.
#
# Copyright (c) 2017 Open Source Foundries Limited
#
# SPDX-License-Identifier: Apache-2.0
#
# This provides a basic application structure suitable for loading by
# mcuboot, which is easy to customize on a per-board basis. It can be
# used as a starting point for new applications.

# The default top-level application configuration is prj.conf.
# You can place additional board-specific files in boards/${BOARD}.conf,
# and they will be merged into the configuration along with prj.conf.
macro(set_conf_file)
  if(EXISTS ${APPLICATION_SOURCE_DIR}/boards/${BOARD}.conf)
    set(CONF_FILE "prj.conf ${APPLICATION_SOURCE_DIR}/boards/${BOARD}.conf")
  else()
    set(CONF_FILE "prj.conf")
  endif()
endmacro()

# Standard Zephyr application boilerplate.
include($ENV{ZEPHYR_BASE}/cmake/app/boilerplate.cmake NO_POLICY_SCOPE)
project(NONE)

# Choice hard board
set(SMART_BUILD_BOARD $ENV{SMART_BUILD_BOARD})
if(SMART_BUILD_BOARD STREQUAL "SMART_LINK_V133")
    message("Choice build v133 board ")
    set(SMART_LINK_V133 true)
elseif(SMART_BUILD_BOARD STREQUAL "SMART_LINK_V131")
    message("Choice build v131 board")
    set(SMART_LINK_V131 true)
elseif(SMART_BUILD_BOARD STREQUAL "SMART_LINK_V141")
    message("Choice build v141 board")
    set(SMART_LINK_V141 true)
else()
    #define set v133 board
    set(SMART_LINK_V133 true)
endif()

include($ENV{ZEPHYR_BASE}/apps/linde/version.cmake)
configure_file(version.h.in ${PROJECT_BINARY_DIR}/include/smart_link_version.h)
INCLUDE_DIRECTORIES(${PROJECT_BINARY_DIR}/include)

ADD_DEFINITIONS(-DMQTT_COMM_ENABLED=y)
ADD_DEFINITIONS(-DMQTT_DEVICE_SHADOW=n)
ADD_DEFINITIONS(-DCOAP_COMM_ENABLED=n)
ADD_DEFINITIONS(-DOTA_COMM_ENABLED=y)
ADD_DEFINITIONS(-DOTA_SIGNAL_CHANNEL=MQTT)
ADD_DEFINITIONS(-DAUTH_MODE=KEY)
ADD_DEFINITIONS(-DAUTH_MODE_KEY=y)
ADD_DEFINITIONS(-DAUTH_WITH_NOTLS=y)
ADD_DEFINITIONS(-DSYSTEM_COMM_ENABLED=y)

ADD_DEFINITIONS(-DRELEASE_VERSION)

# Used for All board ***************
INCLUDE_DIRECTORIES(
    src/fs
    src/fs/fatfs
    src/fs/fatfs/drivers
    src/fs/fatfs/optoin
    src/protocol
    src/networkingThread
    src/utils
    src/rfid
    src/vehicle_ctrl
    src/inter-thread_comm
    src/thread
    src/mpu
    src/fota
    src/networkingThread/cache
    src/factory_test
    lib/can/include
	src/work_data/rs485_sensor_thread
	
    src/netlib
    src/qcloud
    src/qcloud/src
    src/qcloud/src/coap/include
    src/qcloud/src/device/include
    src/qcloud/src/mqtt/include
    src/qcloud/src/nbiot/include
    src/qcloud/src/ota/include
    src/qcloud/src/sdk-impl
    src/qcloud/src/sdk-impl/exports
    src/qcloud/src/shadow/include
    src/qcloud/src/utils/digest
    src/qcloud/src/utils/farra
    src/qcloud/src/utils/lite
    src
)
# **************************************

# Choice mpu mpu6050 or bmi160
if(SMART_LINK_V131)
    INCLUDE_DIRECTORIES(src/mpu/mpu6050)
    aux_source_directory(src/mpu/mpu6050 MPU6050)
    target_sources(app PRIVATE ${MPU6050})
elseif(SMART_LINK_V133 OR SMART_LINK_V141)
    INCLUDE_DIRECTORIES(src/mpu/bmi160)
    aux_source_directory(src/mpu/bmi160 BMI160)
    target_sources(app PRIVATE ${BMI160})
else()
    message("No board")
endif()

# Choice can
if(SMART_LINK_V131 OR SMART_LINK_V133)
    INCLUDE_DIRECTORIES(src/work_data/can)
#    INCLUDE_DIRECTORIES(src/work_data/can/rs485_sensor_thread)
	INCLUDE_DIRECTORIES(src/factory_test/v133_factory_test)
    aux_source_directory(src/work_data/can WORK_DATA)
#    aux_source_directory(src/work_data/can/rs485_sensor_thread CARRY_SENSOR)
	aux_source_directory(src/factory_test/v133_factory_test V133_FACTORY_TEST)
#    target_sources(app PRIVATE ${CARRY_SENSOR})
	target_sources(app PRIVATE ${V133_FACTORY_TEST})
elseif(SMART_LINK_V141)
    INCLUDE_DIRECTORIES(src/work_data/no_can)
	INCLUDE_DIRECTORIES(src/work_data/no_can/fork_sensor)
	INCLUDE_DIRECTORIES(src/work_data/no_can/move_sensor)
	INCLUDE_DIRECTORIES(src/work_data/no_can/genenal_sensor)
	INCLUDE_DIRECTORIES(src/factory_test/v141_factory_test)
	aux_source_directory(src/factory_test/v141_factory_test V141_FACTORY_TEST)
	aux_source_directory(src/work_data/no_can WORK_DATA)
    aux_source_directory(src/work_data/no_can/fork_sensor FORK_SENSOR)
	aux_source_directory(src/work_data/no_can/move_sensor MOVE_SENSOR)
	aux_source_directory(src/work_data/no_can/genenal_sensor GENENAL_SENSOR)
	target_sources(app PRIVATE ${V141_FACTORY_TEST})
    target_sources(app PRIVATE ${FORK_SENSOR})
	target_sources(app PRIVATE ${MOVE_SENSOR})
	target_sources(app PRIVATE ${GENENAL_SENSOR})
else()
    message("No board")
endif()

#choose beep type 
if(SMART_LINK_V131 OR SMART_LINK_V133)
	INCLUDE_DIRECTORIES(src/vehicle_ctrl/active_beep)
	aux_source_directory(src/vehicle_ctrl/active_beep VEHICL_BEEP)
elseif(SMART_LINK_V141)
	INCLUDE_DIRECTORIES(src/vehicle_ctrl/passive_beep)
	aux_source_directory(src/vehicle_ctrl/passive_beep VEHICL_BEEP)
else()
	message("NO Board")
endif()

# choise hard version
if(SMART_LINK_V133)
    INCLUDE_DIRECTORIES(src/utils/v133)
    aux_source_directory(src/utils/v133 HARD_VERSION)
    target_sources(app PRIVATE ${HARD_VERSION})
elseif(SMART_LINK_V131)
    INCLUDE_DIRECTORIES(src/utils/v131)
    aux_source_directory(src/utils/v131 HARD_VERSION)
    target_sources(app PRIVATE ${HARD_VERSION})
elseif(SMART_LINK_V141)
    INCLUDE_DIRECTORIES(src/utils/v141)
    aux_source_directory(src/utils/v141 HARD_VERSION)
    target_sources(app PRIVATE ${HARD_VERSION})
endif()

# **** Used for All board *************************************************
aux_source_directory(src/ SRC)
aux_source_directory(src/rfid/ RFID)
aux_source_directory(src/vehicle_ctrl/ CTRL)
aux_source_directory(src/mpu/ MPU)
aux_source_directory(src/fota/ FOTA)
aux_source_directory(src/thread THREAD)
aux_source_directory(src/inter-thread_comm INTER_THREAD_COMM)
aux_source_directory(src/protocol/ PROTOCOL)
aux_source_directory(src/utils/ UTILS)
aux_source_directory(src/networkingThread/ NETWORKING)
aux_source_directory(src/networkingThread/cache/ CACHE)
aux_source_directory(src/fs/ FS)
aux_source_directory(src/fs/fatfs/ FS_FATFS)
aux_source_directory(src/fs/fatfs/drivers/ FS_FATFS_DRIVERS)
aux_source_directory(src/factory_test FACTORY_TEST)
aux_source_directory(src/work_data/rs485_sensor_thread CARRY_SENSOR)
set(FS_FATFS_OPTION src/fs/fatfs/option/syscall.c src/fs/fatfs/option/unicode.c)

target_sources(app PRIVATE 
    ${SRC}
    ${FS} ${FS_FATFS} ${FS_FATFS_DRIVERS} ${FS_FATFS_OPTION}
    ${PROTOCOL}
    ${UTILS}
    ${RFID}
    ${CTRL}
    ${MPU}
    ${WORK_DATA}
    ${INTER_THREAD_COMM}
    ${NETWORKING}
    ${THREAD}
    ${FOTA}
    ${CACHE}
    ${FACTORY_TEST}
    ${RS485_SENSOR_THREAD}
	${VEHICL_BEEP}
    ${CARRY_SENSOR}
    
    src/qcloud/src/device/src/device.c

    src/qcloud/src/mqtt/src/mqtt_client.c
    src/qcloud/src/mqtt/src/mqtt_client_common.c
    src/qcloud/src/mqtt/src/mqtt_client_connect.c
    src/qcloud/src/mqtt/src/mqtt_client_net.c
    src/qcloud/src/mqtt/src/mqtt_client_publish.c
    src/qcloud/src/mqtt/src/mqtt_client_subscribe.c
    src/qcloud/src/mqtt/src/mqtt_client_yield.c
    
    src/qcloud/src/utils/digest/utils_base64.c
    
    src/qcloud/src/utils/farra/utils_list.c
    src/qcloud/src/utils/farra/utils_net.c
    src/qcloud/src/utils/farra/utils_timer.c
    
    src/qcloud/src/platform/os/zephyr/HAL_OS_linux.c
    src/qcloud/src/platform/os/zephyr/HAL_TCP_linux.c
    src/qcloud/src/platform/os/zephyr/HAL_Timer_linux.c

    src/netlib/atcip.c
    src/netlib/atc.c
    src/netlib/atd.c  
    src/netlib/gpio.c
    src/netlib/gpd.c
)
# *************************************************************************

#Choice link library
if(SMART_LINK_V133 OR SMART_LINK_V131)
    link_directories("lib/can")
    execute_process(COMMAND cp ${PROJECT_SOURCE_DIR}/lib/can/libcan.a ./zephyr)
    target_link_libraries(app libcan.a)
elseif(SMART_LINK_V141)
    #Custom Connection Library of v141
endif()
```

## prj.conf
```kconfig
CONFIG_GPIO=y
CONFIG_SERIAL=y
CONFIG_UART_INTERRUPT_DRIVEN=y
CONFIG_USE_STM32_HAL_GPIO=y
CONFIG_USE_STM32_HAL_GPIO_EX=y
CONFIG_USE_STM32_HAL_ADC=y
CONFIG_USE_STM32_HAL_ADC_EX=y
CONFIG_USE_STM32_HAL_CAN=y
CONFIG_FLOAT=y
CONFIG_JSON_LIBRARY=y
```

## boards/aidong_linde429v13.conf
```kconfig
# Print a banner on the UART on startup.
CONFIG_BOOT_BANNER=y
CONFIG_BUILD_TIMESTAMP=y

# Enable console and printk()
CONFIG_PRINTK=y
CONFIG_STDOUT_CONSOLE=y

# Enable Zephyr application to be booted by MCUboot
CONFIG_BOOTLOADER_MCUBOOT=y

CONFIG_FLASH=y
CONFIG_MPU_ALLOW_FLASH_WRITE=y
CONFIG_IMG_MANAGER=y
CONFIG_MCUBOOT_IMG_MANAGER=y
CONFIG_IMG_BLOCK_BUF_SIZE=512

CONFIG_USE_STM32_HAL_ADC=y
CONFIG_USE_STM32_HAL_ADC_EX=y
CONFIG_DMA=y
CONFIG_DMA_0_NAME="DMA_0"
CONFIG_DMA_0_IRQ_PRI=3
CONFIG_DMA_1_NAME="DMA_1"
CONFIG_DMA_1_IRQ_PRI=3
CONFIG_DMA_2_NAME="DMA_2"
CONFIG_DMA_2_IRQ_PRI=3
CONFIG_SYS_LOG_DMA_LEVEL=0
CONFIG_DMA_STM32F4X=y
CONFIG_DMA_0_RX_SUB_CHANNEL_ID=0
CONFIG_DMA_0_TX_SUB_CHANNEL_ID=0
CONFIG_DMA_1_RX_SUB_CHANNEL_ID=4
CONFIG_DMA_1_TX_SUB_CHANNEL_ID=4
CONFIG_DMA_2_RX_SUB_CHANNEL_ID=4
CONFIG_DMA_2_TX_SUB_CHANNEL_ID=4

CONFIG_USE_STM32_HAL_MMC=y
```

## boards/aidong_linde429v14.conf
```kconfig
# Print a banner on the UART on startup.
CONFIG_BOOT_BANNER=y
CONFIG_BUILD_TIMESTAMP=y

# Enable console and printk()
CONFIG_PRINTK=y
CONFIG_STDOUT_CONSOLE=y

# Enable Zephyr application to be booted by MCUboot
CONFIG_BOOTLOADER_MCUBOOT=y

CONFIG_FLASH=y
CONFIG_MPU_ALLOW_FLASH_WRITE=y
CONFIG_IMG_MANAGER=y
CONFIG_MCUBOOT_IMG_MANAGER=y
CONFIG_IMG_BLOCK_BUF_SIZE=512

CONFIG_USE_STM32_HAL_ADC=y
CONFIG_USE_STM32_HAL_ADC_EX=y
CONFIG_DMA=y
CONFIG_DMA_0_NAME="DMA_0"
CONFIG_DMA_0_IRQ_PRI=3
CONFIG_DMA_1_NAME="DMA_1"
CONFIG_DMA_1_IRQ_PRI=3
CONFIG_DMA_2_NAME="DMA_2"
CONFIG_DMA_2_IRQ_PRI=3
CONFIG_SYS_LOG_DMA_LEVEL=0
CONFIG_DMA_STM32F4X=y
CONFIG_DMA_0_RX_SUB_CHANNEL_ID=0
CONFIG_DMA_0_TX_SUB_CHANNEL_ID=0
CONFIG_DMA_1_RX_SUB_CHANNEL_ID=4
CONFIG_DMA_1_TX_SUB_CHANNEL_ID=4
CONFIG_DMA_2_RX_SUB_CHANNEL_ID=4
CONFIG_DMA_2_TX_SUB_CHANNEL_ID=4

CONFIG_USE_STM32_HAL_MMC=y
```

## src/main.c
```c
#include <stdio.h>
#include <kernel.h>
#include <string.h>

#include "my_misc.h"
#include "rtc.h"
#include "config.h"
#include "rfid_thread.h"
#include "vehicle_ctrl_thread.h"
#include "fifo.h"
#include "file.h"
#include "sempho.h"
#include "msg_structure.h"
#include "thread_mpu.h"
#include "config.h"
#include "message_center_thread.h"
#include "thread_work_data.h"
#include "thread_wdt.h"
#include "thread_led.h"
#include "smart_link_version.h"
#include "fota_upgrade_thread.h"
#include "network_thread.h"
#include "thread_file.h"
#include "my_tool.h"
#include "hw_version.h"
#include "thread_stb.h"

sysconfig_t gSysconfigBackup;
sysconfig_t gSysconfig;

static void checkPowerOffMsg();
extern void detect_thread_message_center(uint32_t ts);
extern void detect_thread_offline_thread(uint32_t ts);

int main(int argc, char* argv[])
{
    /* step first power hold enable */
    hwPowerEnable();

    /* get hw version */
    getHardVersion(&g_hw_major, &g_hw_minor, &g_hw_tiny, &g_hw_patch);

    /* print version */
    print_version();
    print_hw_version();

    /* step init led */
    thread_led_stat_init();
    thread_led_stat_set(LED_STAT_ON, 1);
    thread_led_stat_set(LED_STAT_NO_COMM_SIGNAL, 1);  //no net

    /* step init RTC */
    initRTC();
    localRTC_t rtc;
    if(getRTC(&rtc))
    {
        printRTC(&rtc);
    }

    /* step init sem */
    if(!semInit())
    {
        err_log("semInit failed");
        return -1;
    }
    /* step init fifo */
    if(!fifoInit())
    {
        err_log("fifoInit failed");
        return -2;
    }

    /* step start file thread */
    startThreadFile();

    /* step delay fs init ok */
    print_log("wait for Init fs and load config.\n");
    semTakeInitFsOk();
    print_log("load config and main loop.\n");

    /* step power callback */
    hwPowerCallbackInit(gSysconfig.canType, gSysconfig.authType);

    /* step strt wdt */
    thread_wdt_start(6000);

    /* step start network thread */
    uint16_t      hbTimeOut = check_min(gSysconfig.hbTimeout, HB_INTERVAL_MIN);
    networkPara_t netPra    = { .hb_timeout       = hbTimeOut,
                             .auto_fota_switch = gSysconfig.autoFotaSwitch };
    networkThreadStart(netPra);

    /* step start message center thread */
    uint16_t      gpsInterval = check_min(gSysconfig.gpsUploadInterval, GPS_INTERVAL_MIN);
    messagePara_t para        = { .gGpsIntrval = gpsInterval,
                           .gHbTimeOut  = hbTimeOut,
                           .gHbInterval = gSysconfig.hbInterval,
                           .gCarStateInterval =
                               check_range(gSysconfig.onlineStateInterval, CAR_STATE_INTERVAL_MIN,
                                           CAR_STATE_INTERVAL_MAX),
                           .gCarStateOfflineInterval = check_range(gSysconfig.offlineStateInterval,
                                                                   CAR_STATE_OFFLINE_INTERVAL_MIN,
                                                                   CAR_STATE_OFFLINE_INTERVAL_MAX),
                           .authType                 = gSysconfig.authType };
    messageCenterTHreadStart(para);

    /* step start gps thred */
    startGpsThread(&gpsInterval);

    /* step start BMI160 thread */
    speedLimitConfig_t mseConfig = {
        gSysconfig.mseThreshold,       gSysconfig.vibrationLimitThreshold,
        gSysconfig.crashLowThreshold,  gSysconfig.crashMiddleThreshold,
        gSysconfig.crashHighThreshold, gSysconfig.crashSwitch
    };
    print_log("MSE Threshold:[%d].\n", mseConfig.vibration_threshold);
    threadMpuStart(&mseConfig);

    /* step start can thread */
    print_log("Can type: %d,gConfigFlag =%d\n", gSysconfig.canType, gConfigFlag);
    if(gSysconfig.canType != 200 && false == gConfigFlag)
    {
        uint16_t canInterval =
            check_range(gSysconfig.canMaxuploadInterval, CAN_INTERVAL_MIN, CAN_INTERVAL_MAX);
        uint16_t offlineCanInterval =
            check_range(gSysconfig.offlineCanInterval, CAN_OFFLINE_INTERVAL_MIN, CAN_INTERVAL_MAX);
        int8_t seatType = 0;
        if(gSysconfig.seatType == 1 || gSysconfig.seatType == 2)
        {
            seatType = gSysconfig.seatType;
        }
        else
        {
            seatType = gSeatTypeConfig.seatType;
        }


        workDataPara_t canPara = {
            .canType            = gSysconfig.canType,
            .canPattern         = gSysconfig.canPattern,
            .authType           = gSysconfig.authType,
            .interval           = canInterval,
            .seatTimeOut        = gSysconfig.seatoffTimeout,
            .overSpeed          = gSysconfig.overspeedAlarmThreshold,
            .pressEnble         = gMemconfig.pressEnable,
            .carry_threshold    = gSysconfig.carry_threshold,
            .overload_threshold = gSysconfig.overload_threshold,
            .move_type          = gSysconfig.moveType,
            .fork_type          = gSysconfig.forkType,
            .move_threshold     = gSysconfig.moveThreshold,  //nocan config ---mA
            .fork_threshold     = gSysconfig.forkThreshold,
            .seatType           = seatType,
            .canOfflineInterval = offlineCanInterval,
        };
        startWorkDataThread(canPara);
    }

    /* chiose auth type */
    print_log("Auth type: %d\n", gSysconfig.authType);
    if((gSysconfig.authType == AUTH_RFID && gSysconfig.canType != 200) || (gConfigFlag == true))
    {
        /* step start RFID thread */
        rfidThreadStart();

        /* step start vehicle ctrl thread */
        vehPara_t para = { .mode = MODE_OFFICAL };
        if(gConfigFlag == true)
        {
            para.mode = MODE_ABNORMAL;
        }
        vehclCtrlThreadStart(&para);
    }

    //aidong factory test
    print_log("canType[%d],authType[%d],gConfigFlag[%d]\n", gSysconfig.canType, gSysconfig.authType,
              gConfigFlag);
    if(gSysconfig.canType == 200 && gSysconfig.authType == AUTH_NONE && false == gConfigFlag)
    {
        print_log("enter aidong factory test mode\n");
        testStart_t testPars = { FACTORY_MODE, 0, 0, 0 };
        factoryTestThreadStart(testPars);
    }
    //print_log("test1");
    startThreadSTB();
    //print_log("test2");

    int i       = 0;
    int counter = 0;
    while(1)
    {
        uint32_t curr_ts = k_uptime_get_32();

        detect_thread_mpu(curr_ts);
        detect_thread_message_center(curr_ts);
        detect_thread_offline_thread(curr_ts);
        // detect_thread_nerwork_thread(curr_ts);
        detect_thread_file(curr_ts);

        if(200 != gSysconfig.canType)
        {
            detect_workdata_thread(curr_ts);
        }


        counter++;
        if(counter % 20 == 0)
        {
            print_log("main loop counter [%d] ----------.\n", ++i);
        }

        k_sleep(2000);
    }

    return 0;
}
```
