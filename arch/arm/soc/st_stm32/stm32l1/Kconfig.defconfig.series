## arch/arm/soc/st_stm32/stm32l1/Kconfig.defconfig.series
```kconfig
# Kconfig - ST Microelectronics STM32L1 MCU line
#
# Copyright (c) 2018 Endre Karlson <endre.karlson@gmail.com>
#
# SPDX-License-Identifier: Apache-2.0
#

if SOC_SERIES_STM32L1X

gsource "arch/arm/soc/st_stm32/stm32l1/Kconfig.defconfig.stm32l1*"

config SOC_SERIES
	default "stm32l1"

if GPIO_STM32

endif # GPIO_STM32

if I2C_STM32

config  I2C_STM32_V2
	def_bool y

endif # I2C_STM32

endif # SOC_SERIES_STM32L1X
```

## arch/arm/soc/st_stm32/stm32l1/Kconfig.defconfig.stm32l151xc
```kconfig
# Kconfig - ST Microelectronics STM32L151XC MCU
#
# Copyright (c) 2018 Ilya Tagunov <tagunil@gmail.com>
#
# SPDX-License-Identifier: Apache-2.0
#

if SOC_STM32L151XC

config SOC
	string
	default "stm32l151xc"

config NUM_IRQS
	int
	default 45

if GPIO_STM32

config GPIO_STM32_PORTD
	default y

config GPIO_STM32_PORTE
	default y

config GPIO_STM32_PORTH
	default y

endif # GPIO_STM32

endif # SOC_STM32L151XC
```

## arch/arm/soc/st_stm32/stm32l1/Kconfig.series
```kconfig
# Kconfig - ST Microelectronics STM32L1 MCU series
#
# Copyright (c) 2018 Endre Karlson <endre.karlson@gmail.com>
# Copyright (c) 2018 Rainbonic Technology Corporation
#
# SPDX-License-Identifier: Apache-2.0
#

config SOC_SERIES_STM32L1X
	bool "STM32L1x Series MCU"
	select CPU_CORTEX_M3
	select SOC_FAMILY_STM32
	select SYS_POWER_LOW_POWER_STATE_SUPPORTED
	select HAS_STM32CUBE
	select CPU_HAS_MPU
	select CPU_HAS_SYSTICK
	select CLOCK_CONTROL_STM32_CUBE if CLOCK_CONTROL
	help
	  Enable support for STM32L1 MCU series
```

## arch/arm/soc/st_stm32/stm32l1/Kconfig.soc
```kconfig
# Kconfig - ST Microelectronics STM32L1 MCU line
#
# Copyright (c) 2018 Endre Karlson <endre.karlson@gmail.com>
#
# SPDX-License-Identifier: Apache-2.0
#

choice
prompt "STM32L1x MCU Selection"
depends on SOC_SERIES_STM32L1X

config SOC_STM32L151XB
	bool "STM32L151XB"

config SOC_STM32L151XC
	bool "STM32L151XC"

endchoice
```

## boards/arm/aidong_linde429v13/Kconfig.board
```kconfig
# Kconfig - Aidong Linde429 V13 board configuration
#
# Copyright (c) 2016 Linaro Limited.
#
# SPDX-License-Identifier: Apache-2.0
#

config BOARD_AIDONG_LINDE429V13
	bool "Aidong Linde429 V13 Board"
	depends on SOC_STM32F429XI
```

## boards/arm/aidong_linde429v13/Kconfig.defconfig
```kconfig
# Kconfig - Aidong Linde429 V13 board configuration
#
# Copyright (c) 2016 Linaro Limited.
#
# SPDX-License-Identifier: Apache-2.0
#

if BOARD_AIDONG_LINDE429V13

config BOARD
	default aidong_linde429v13

if UART_CONSOLE

config UART_STM32_PORT_1
	default y

endif # UART_CONSOLE

endif # BOARD_AIDONG_LINDE429V13
```

## boards/arm/aidong_linde429v14/Kconfig.board
```kconfig
# Kconfig - Aidong Linde429 V14 board configuration
#
# Copyright (c) 2016 Linaro Limited.
#
# SPDX-License-Identifier: Apache-2.0
#

config BOARD_AIDONG_LINDE429V14
	bool "Aidong Linde429 V14 Board"
	depends on SOC_STM32F429XI
```

## boards/arm/aidong_linde429v14/Kconfig.defconfig
```kconfig
# Kconfig - Aidong Linde429 V14 board configuration
#
# Copyright (c) 2016 Linaro Limited.
#
# SPDX-License-Identifier: Apache-2.0
#

if BOARD_AIDONG_LINDE429V14

config BOARD
	default aidong_linde429v14

if UART_CONSOLE

config UART_STM32_PORT_1
	default y

endif # UART_CONSOLE

endif # BOARD_AIDONG_LINDE429V14
```

## boards/arm/rainbonic_l151cc/Kconfig.board
```kconfig
# Kconfig - Rainbonic development board with STM32L151CC MCU configuration
#
# Copyright (c) 2018 Ilya Tagunov <tagunil@gmail.com>
# Copyright (c) 2018 Rainbonic Technology Corporation
#
# SPDX-License-Identifier: Apache-2.0
#

config BOARD_RAINBONIC_L151CC
	bool "Rainbonic L151CC Development Board"
	depends on SOC_STM32L151XC
```

## boards/arm/rainbonic_l151cc/Kconfig.defconfig
```kconfig
# Kconfig - Rainbonic development board with STM32L151CC MCU
#
# Copyright (c) 2018 Ilya Tagunov <tagunil@gmail.com>
# Copyright (c) 2018 Rainbonic Technology Corporation
#
# SPDX-License-Identifier: Apache-2.0
#

if BOARD_RAINBONIC_L151CC

config BOARD
	default "rainbonic_l151cc"

if UART_CONSOLE

config UART_STM32_PORT_1
	default y

endif # UART_CONSOLE

config UART_STM32_PORT_2
	default y

config UART_STM32_PORT_3
	default y

endif # BOARD_RAINBONIC_L151CC
```

## boards/arm/rainbonic_l151cc/rainbonic_l151cc_defconfig
```kconfig
# Zephyr Kernel Configuration
CONFIG_ARM=y
CONFIG_SOC_SERIES_STM32L1X=y

# Platform Configuration
CONFIG_SOC_STM32L151XC=y
CONFIG_BOARD_RAINBONIC_L151CC=y

# General Kernel Options
CONFIG_CORTEX_M_SYSTICK=y
CONFIG_SYS_CLOCK_HW_CYCLES_PER_SEC=32000000

# Serial Drivers
CONFIG_SERIAL=y
CONFIG_UART_INTERRUPT_DRIVEN=y
# enable console
CONFIG_CONSOLE=y
CONFIG_UART_CONSOLE=y

# Pinmux Driver
CONFIG_PINMUX=y

# GPIO Controller
CONFIG_GPIO=y

# Clock configuration
CONFIG_CLOCK_CONTROL=y
# SYSCLK selection
CONFIG_CLOCK_STM32_SYSCLK_SRC_PLL=y
# HSE configuration
CONFIG_CLOCK_STM32_HSE_CLOCK=24000000
# The board use an external oscillator of 24MHz
CONFIG_CLOCK_STM32_HSE_BYPASS=n
# PLL configuration
CONFIG_CLOCK_STM32_PLL_SRC_HSE=y
# produce 32MHz clock at PLL output
CONFIG_CLOCK_STM32_PLL_MULTIPLIER=4
CONFIG_CLOCK_STM32_PLL_DIVISOR=3
CONFIG_CLOCK_STM32_AHB_PRESCALER=1
CONFIG_CLOCK_STM32_APB1_PRESCALER=1
CONFIG_CLOCK_STM32_APB2_PRESCALER=1

# DMA driver
CONFIG_DMA_STM32L1X=y
```

## drivers/dma/Kconfig.stm32l1x
```kconfig
# Kconfig - DMA configuration options
#
#
# Copyright (c) 2016 Intel Corporation
#
# SPDX-License-Identifier: Apache-2.0
#

menuconfig DMA_STM32L1X
	bool "Enable STM32L1x DMA driver"
	default n
	depends on SOC_SERIES_STM32L1X
	help
	  DMA driver for STM32L1x series SoCs.
```

## mcuboot/samples/zephyr/hello-world/boards/aidong_linde429v13.conf
```kconfig
# Print a banner on the UART on startup.
CONFIG_BOOT_BANNER=y
CONFIG_BUILD_TIMESTAMP=y

# Enable console and printk()
CONFIG_PRINTK=y
CONFIG_STDOUT_CONSOLE=y

# Enable Zephyr application to be booted by MCUboot
CONFIG_BOOTLOADER_MCUBOOT=y

CONFIG_FLASH=y
CONFIG_MPU_ALLOW_FLASH_WRITE=y
CONFIG_IMG_MANAGER=y
CONFIG_MCUBOOT_IMG_MANAGER=y
CONFIG_IMG_BLOCK_BUF_SIZE=512
```
